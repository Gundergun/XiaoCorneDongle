## boards/shields/corne_xiao_v1/Kconfig.defconfig
```kconfig
if SHIELD_CORNE_XIAO_V1_DONGLE

config ZMK_KEYBOARD_NAME
    default "Corne Dongle"

config ZMK_SPLIT_ROLE_CENTRAL
    default y

endif

if SHIELD_CORNE_XIAO_V1_DONGLE || SHIELD_CORNE_XIAO_V1_LEFT  || SHIELD_CORNE_XIAO_V1_RIGHT

config ZMK_SPLIT
    default y

endif
```
